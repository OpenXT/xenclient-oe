## conf/distro/include/openxt-ocaml.inc
```bitbake
SYSROOT_OCAML_PATH = "${STAGING_DIR_NATIVE}${libdir_native}/${TRANSLATED_TARGET_ARCH}${TARGET_VENDOR}-${TARGET_OS}/ocaml"
export OCAML_STDLIBDIR = "${SYSROOT_OCAML_PATH}/site-lib"
OCAML_HEADERS = "${SYSROOT_OCAML_PATH}"
export ocamllibdir = "${libdir}/ocaml"
export STAGING_LIBDIR_OCAML = "${STAGING_LIBDIR}/ocaml"
OCAML_FINDLIB_CONF = "${STAGING_DIR_HOST}${sysconfdir}/findlib.conf"
```

## conf/distro/include/openxt-preferred.inc
```bitbake
PREFERRED_PROVIDER_virtual/kernel ?= "linux-openxt"
PREFERRED_VERSION_linux-openxt ?= "4.9%"

PREFERRED_VERSION_linux-libc-headers ?= "${@"${PREFERRED_VERSION_linux-openxt}".rstrip('%')}"
PREFERRED_VERSION_linux-libc-headers-nativesdk ?= "${@"${PREFERRED_VERSION_linux-openxt}".rstrip('%')}"

PREFERRED_PROVIDER_openssl = "openssl"
PREFERRED_PROVIDER_openssl-native = "openssl-native"
PREFERRED_PROVIDER_libcrypto = "libcrypto"
PREFERRED_PROVIDER_libssl = "libssl"
PREFERRED_PROVIDER_openssl-conf = "openssl-conf"
PREFERRED_PROVIDER_nativesdk-openssl = "nativesdk-openssl"
PREFERRED_PROVIDER_nativesdk-openssl-conf = "nativesdk-openssl-conf"

PREFERRED_PROVIDER_console-tools = "console-tools"
PREFERRED_PROVIDER_virtual/libx11 = "libx11"

PREFERRED_VERSION_dojosdk-native ?= "1.7.2"
# ${MACHINE}.conf is overriden by ${DISTRO}.conf
# xenmgr_data and sync-wui (uivm and syncui machines) apparently depends on
# different versions, so preserve that.
PREFERRED_VERSION_dojosdk-native_xenclient-syncui ?= "1.8.1"

# Force specific package versions
PREFERRED_VERSION_grub = "2.00+AUTOINC%"
PREFERRED_VERSION_networkmanager = "0.9.2.0"
PREFERRED_VERSION_network-manager-applet = "0.9.2.0"
PREFERRED_VERSION_wpa-supplicant = "2.6"

PREFERRED_VERSION_midori = "0.1.8"
PREFERRED_VERSION_webkit-gtk = "1.8.3"

PREFERRED_VERSION_fontsproto = "2.1.3"
PREFERRED_VERSION_gnome-keyring = "2.32.1"

PREFERRED_VERSION_refpolicy-mcs = "2.20141203"

# Select our preferred providers
PREFERRED_PROVIDER_sysvinit-inittab = "sysvinit"
PREFERRED_PROVIDER_virtual/java-initial = "cacao-initial"
PREFERRED_PROVIDER_virtual/java-initial-native = "cacao-initial-native"
PREFERRED_PROVIDER_virtual/java-native = "jamvm-native"
PREFERRED_PROVIDER_virtual/javac-native = "ecj-bootstrap-native"
PREFERRED_PROVIDER_jpeg-native = "jpeg-native"

# Allow build of multiple packages containing xenstore daemons
MULTI_PROVIDER_WHITELIST += "xen-xenstored"
# Select a preferred XenStored daemon implementation.
PREFERRED_PROVIDER_xen-xenstored = "xen"
```

## conf/distro/linux-3.18.conf
```bitbake
#
# This is how bitbake will establishes its configuration:
#
# require conf/abi_version.conf
# include conf/site.conf
# include conf/auto.conf
# include conf/local.conf
# include conf/build/${BUILD_SYS}.conf
# include conf/target/${TARGET_SYS}.conf
# include conf/machine/${MACHINE}.conf
# include conf/machine-sdk/${SDKMACHINE}.conf
# include conf/distro/${DISTRO}.conf
# include conf/distro/defaultsetup.conf
# include conf/documentation.conf
# include conf/licenses.conf
# require conf/sanity.conf
#
# Here we use this distro setting to match our linux uprev agenda.

PREFERRED_VERSION_linux-libc-headers = "3.18%"
PREFERRED_VERSION_linux-libc-headers-nativesdk = "${PREFERRED_VERSION_linux-libc-headers}"

PREFERRED_VERSION_linux-xenclient-dom0 = "3.18%"
PREFERRED_VERSION_linux-xenclient-ndvm = "3.18%"
PREFERRED_VERSION_linux-xenclient-nilfvm = "3.18%"
PREFERRED_VERSION_linux-xenclient-stubdomain = "3.18%"
PREFERRED_VERSION_linux-xenclient-syncvm = "3.18%"
PREFERRED_VERSION_linux-xenclient-uivm = "3.18%"
```

## conf/distro/openxt-linux-4.4.conf
```bitbake
#
# This is how bitbake will establish its configuration:
#
# require conf/abi_version.conf
# include conf/site.conf
# include conf/auto.conf
# include conf/local.conf
# include conf/build/${BUILD_SYS}.conf
# include conf/target/${TARGET_SYS}.conf
# include conf/machine/${MACHINE}.conf
# include conf/machine-sdk/${SDKMACHINE}.conf
# include conf/distro/${DISTRO}.conf
# include conf/distro/defaultsetup.conf
# include conf/documentation.conf
# include conf/licenses.conf
# require conf/sanity.conf
#

PREFERRED_VERSION_linux-openxt ?= "4.4%"

require conf/distro/openxt-main.conf
```

## conf/distro/openxt-main.conf
```bitbake
#
# This is how bitbake will establish its configuration:
#
# require conf/abi_version.conf
# include conf/site.conf
# include conf/auto.conf
# include conf/local.conf
# include conf/build/${BUILD_SYS}.conf
# include conf/target/${TARGET_SYS}.conf
# include conf/machine/${MACHINE}.conf
# include conf/machine-sdk/${SDKMACHINE}.conf
# include conf/distro/${DISTRO}.conf
# include conf/distro/defaultsetup.conf
# include conf/documentation.conf
# include conf/licenses.conf
# require conf/sanity.conf
#

# openembedded-core sets a default list of DISTRO_FEATURES that do not match
# OpenXT's machine needs.
# See: openembedded-core/meta/conf/distro/include/default-distrovars.inc
# Another way would be hard setting DISTRO_FEATURES.
# Another way would be to redefine DISTRO_FEATURES_DEFAULT.
# Down the road this should probably be a machine config thing so it is possible
# to have images that do not include selinux
DISTRO_FEATURES_remove = "zeroconf nfs"
DISTRO_FEATURES_append += "pam selinux multiarch virtualization polkit opengl"

# Use OpenXT Linux patched kernel.
PREFERRED_PROVIDER_virtual/kernel = "linux-openxt"
PREFERRED_VERSION_linux-openxt ?= "5.10%"
# Align linux-libc-headers with the preferred kernel version.
PREFERRED_VERSION_linux-libc-headers ?= "${@"${PREFERRED_VERSION_linux-openxt}".rstrip('%')}"
PREFERRED_VERSION_linux-libc-headers-nativesdk ?= "${@"${PREFERRED_VERSION_linux-openxt}".rstrip('%')}"

# Dojosdk preferred version.
PREFERRED_VERSION_dojosdk-native ?= "1.7.12"
# ${MACHINE}.conf is overriden by ${DISTRO}.conf
# xenmgr_data and sync-wui (uivm and syncui machines) apparently depends on
# different versions, so preserve that.
PREFERRED_VERSION_dojosdk-native_xenclient-syncui ?= "1.8.1"

# Prefer openssl to libressl.
PREFERRED_PROVIDER_openssl = "openssl"
PREFERRED_PROVIDER_openssl-native = "openssl-native"
PREFERRED_PROVIDER_openssl-conf = "openssl-conf"
PREFERRED_PROVIDER_nativesdk-openssl = "nativesdk-openssl"
PREFERRED_PROVIDER_nativesdk-openssl-conf = "nativesdk-openssl-conf"
# Prefer libcrypto and libssl to alternatives.
PREFERRED_PROVIDER_libcrypto = "libcrypto"
PREFERRED_PROVIDER_libssl = "libssl"

# Prefer libx11 to libx11-diet.
PREFERRED_PROVIDER_virtual/libx11 = "libx11"

# Force specific package versions
PREFERRED_VERSION_networkmanager = "1.18.4"
PREFERRED_VERSION_network-manager-applet = "1.8.22"

PREFERRED_PROVIDER_iasl = "acpica"
PREFERRED_PROVIDER_iasl-native = "${PREFERRED_PROVIDER_iasl}-native"

PREFERRED_VERSION_refpolicy-mcs = "2.20190201"

# Select our preferred providers
PREFERRED_PROVIDER_sysvinit-inittab = "sysvinit"
PREFERRED_PROVIDER_virtual/java-initial = "cacao-initial"
PREFERRED_PROVIDER_virtual/java-initial-native = "cacao-initial-native"
PREFERRED_PROVIDER_virtual/java-native = "jamvm-native"
PREFERRED_PROVIDER_virtual/javac-native = "ecj-bootstrap-native"
PREFERRED_PROVIDER_jpeg-native = "jpeg-native"

# Set the preferred version to C xenstored from xen-tools
PREFERRED_PROVIDER_virtual/xenstored = "xen-tools"
PREFERRED_RPROVIDER_virtual/xenstored = "xen-tools-xenstored"
# Force exclusion of the OCaml xenstored since the above preferences
# are not sufficient to override that as the default selection:
PACKAGE_EXCLUDE += " xen-ocaml-libs-xenstored"

# The C and OCaml xenstored packages can be installed together
# and this whitelisting is necessary to allow both to be built
MULTI_PROVIDER_WHITELIST += " virtual/xenstored"

# Default to rsyslog recipe which RPROVIDES rsyslog-conf
# Dom0 and Installer install rsyslog-conf-dom0 instead.
PREFERRED_RPROVIDER_rsyslog-conf = "rsyslog"

# Enable tui for GDB by default. This makes it easier to debug small things
# using the gdb ipk.
PACKAGECONFIG_append_pn-gdb = " tui"

# rpcgen staging and install paths.
require xc-rpcgen.inc

FILESYSTEM_PERMS_TABLES = "files/openxt-fs-perms.txt"

# Declare the MACHINE type and KERNEL image name for stubdomains
STUBDOMAIN_MACHINE ?= "xenclient-stubdomain"
STUBDOMAIN_KERNEL ?= "bzImage"

# Set our root home
ROOT_HOME = "/root"
```

## conf/distro/xc-rpcgen.inc
```bitbake
#
# rpcgen path definitions.
#

RPCGEN_VERSION = "1.0"

# XML description files for the IDL.
idldatadir = "${datadir}/idl"
# XML description files for Network-manager.
nmidldatadir = "${datadir}/nm-idl"
# Header templates for targeted languages.
rpcgendatadir = "${datadir}/xc-rpcgen-${RPCGEN_VERSION}/templates"
# Staging locations.
STAGING_IDLDATADIR = "${STAGING_DATADIR}/idl"
STAGING_NMIDLDATADIR = "${STAGING_DATADIR}/nm-idl"
STAGING_RPCGENDATADIR_NATIVE = "${STAGING_DATADIR_NATIVE}/xc-rpcgen-${RPCGEN_VERSION}/templates"
```

## conf/layer.conf
```bitbake
# We have a conf and classes directory, append to BBPATH
BBPATH .= ":${LAYERDIR}"

# meta-selinux appends populate-volatiles.sh with commands that will not work
# under a read-only rootfs:
# - liberaly restorecon /var/lib
# - sed checkroot.sh
BBMASK = " \
    meta-selinux/recipes-core/initscripts/ \
    meta-virtualization/recipes-extended/xen/xen_.*\.bb \
"

# We have a recipes directory, add to BBFILES
BBFILES += " \
    ${LAYERDIR}/recipes-*/*/*.bb \
    ${LAYERDIR}/recipes-*/*/*.bbappend \
    ${LAYERDIR}/recipes-*/*/*/*.bb \
    ${LAYERDIR}/recipes-*/*/*/*.bbappend \
"

BBFILE_COLLECTIONS += "xenclient-oe"
BBFILE_PATTERN_xenclient-oe := "^${LAYERDIR}/"
BBFILE_PRIORITY_xenclient-oe = "9"

LAYERVERSION_xenclient-oe = "1"

LICENSE_PATH += " ${LAYERDIR}/files/additional-licenses/"

LAYERDEPENDS_xenclient-oe = " \
    virtualization-layer \
    meta-openxt-haskell-platform \
    meta-openxt-ocaml-platform \
    selinux \
    meta-java \
    intel \
    gnome-layer \
    xfce-layer \
    networking-layer \
    meta-python \
    openembedded-layer \
    core \
"
```

## conf/machine/openxt-common.conf
```bitbake
require conf/machine/include/tune-core2.inc

DEFAULTTUNE = "core2-64"

KERNEL_IMAGETYPE = "bzImage"

MACHINE_FEATURES_BACKFILL_CONSIDERED += "rtc"
```

## conf/machine/openxt-dom0.conf
```bitbake
#@TYPE: Machine
#@NAME: xenclient-dom0
#@DESCRIPTION: Machine configuration for OpenXT dom0.

require openxt-common.conf

MACHINE_FEATURES = " \
    acpi \
    ethernet \
    ext2 \
    keyboard \
    pci \
    rtc \
    screen \
    usbhost \
    x86 \
"

KERNEL_MODULE_AUTOLOAD += " \
    xen-acpi-processor \
    xen-gntalloc \
    xen-gntdev \
    xen-pciback \
    xen-netfront \
"

# Use OpenXT Linux patched kernel.
PREFERRED_PROVIDER_virtual/kernel = "linux-yocto-openxt-dom0"

# Use ivc2/ivcdaemon
PREFERRED_PROVIDER_virtual/libivc = "libivc2"
```

## conf/machine/openxt-installer.conf
```bitbake
# Copyright (C) 2010 Citrix Systems
# Copyright (C) 2018 AIS
# Released under the MIT license (see packages/COPYING)
#@TYPE: Machine
#@NAME: openxt-installer
#@DESCRIPTION: Machine configuration for OpenXT installer

require xenclient-common.conf

MACHINE_FEATURES = "screen keyboard ethernet pci usbhost acpi ext2 x86"
MACHINE_FEATURES += "rtc"
```

## conf/machine/openxt-live-installer.conf
```bitbake
# Copyright (C) 2010 Citrix Systems
# Copyright (C) 2018 AIS
# Released under the MIT license (see packages/COPYING)
#@TYPE: Machine
#@NAME: openxt-installer
#@DESCRIPTION: Machine configuration for OpenXT installer

require xenclient-common.conf

MACHINE_FEATURES = " \
    acpi \
    ethernet \
    ext2 \
    keyboard \
    pci \
    rtc \
    screen \
    usbhost \
    x86 \
"

# Use OpenXT Linux patched kernel.
PREFERRED_PROVIDER_virtual/kernel = "linux-yocto-openxt-installer"
```

## conf/machine/openxt-ndvm.conf
```bitbake
#@TYPE: Machine
#@NAME: openxt-ndvm
#@DESCRIPTION: Machine configuration for OpenXT NDVM.

require openxt-common.conf

MACHINE_FEATURES = " \
    ethernet \
    ext2 \
    pci \
    serial \
    x86 \
"

APPEND = "root=/dev/xvda2 ro console=hvc0 iommu=soft"

USE_VT = "0"

KERNEL_MODULE_AUTOLOAD += " \
    xen-gntalloc \
    xen-gntdev \
    xen-netback \
"

# Use OpenXT Linux patched kernel.
PREFERRED_PROVIDER_virtual/kernel = "linux-yocto-openxt-ndvm"
```

## conf/machine/openxt-stubdom.conf
```bitbake
#@TYPE: Machine
#@NAME: openxt-stubdom
#@DESCRIPTION: Machine configuration for OpenXT stub-domain.

require openxt-common.conf

MACHINE_FEATURES = " \
    ethernet \
    ext2 \
    pci \
    serial \
    x86 \
"

USE_VT = "0"

KERNEL_MODULE_AUTOLOAD += " \
    xen-gntalloc \
    xen-gntdev \
"

# Use OpenXT Linux patched kernel.
PREFERRED_PROVIDER_virtual/kernel = "linux-yocto-openxt-stubdom"

# Use /dev/ivc.
PREFERRED_PROVIDER_virtual/libivc = "libivc"
```

## conf/machine/openxt-uivm.conf
```bitbake
#@TYPE: Machine
#@NAME: openxt-uivm
#@DESCRIPTION: Machine configuration for OpenXT UIVM.

require openxt-common.conf

MACHINE_FEATURES = " \
    ethernet \
    ext2 \
    screen \
    serial \
    x86 \
"

USE_VT = "0"

KERNEL_MODULE_AUTOLOAD += " \
    xen-gntalloc \
    xen-gntdev \
    openxtfb \
"

# Use OpenXT Linux patched kernel.
PREFERRED_PROVIDER_virtual/kernel = "linux-yocto-openxt-uivm"
```

## conf/machine/upgrade-compat.conf
```bitbake
#@TYPE: Machine
#@NAME: upgrade-compat
#@DESCRIPTION: Machine configuration for XenClient compat upgrade rootfs

require xenclient-common.conf

# set empty provider for initscripts as they are different for installer and dom0
# which share the same machine and require different initscritpts
# therefore for every machine using dom0 arch initscripts have to
# be installed separately
VIRTUAL-RUNTIME_initscripts = ""

PREFERRED_PROVIDER_virtual/kernel = "linux-dummy"

MACHINE_FEATURES = "kernel26 screen keyboard ext2 x86"

SERIAL_CONSOLE = "115200 hvc0"

TARGET_ARCH="i686"
DEFAULTTUNE="core2-32"
```

## conf/machine/usbvm.conf
```bitbake
# Copyright (C) 2010 Citrix Systems
# Released under the MIT license (see packages/COPYING)
#@TYPE: Machine
#@NAME: usbvm
#@DESCRIPTION: Machine configuration for USB VM

require xenclient-common.conf

MACHINE_FEATURES = "pci ext2 x86"

APPEND = "root=/dev/xvda2 ro console=hvc0 iommu=soft"

USE_VT = "0"
```

## conf/machine/xenclient-dom0.conf
```bitbake
# Copyright (C) 2010 Citrix Systems
# Released under the MIT license (see packages/COPYING)
#@TYPE: Machine
#@NAME: xenclient-dom0
#@DESCRIPTION: Machine configuration for XenClient dom0 VM

require xenclient-common.conf

PREFERRED_PROVIDER_libgl1 = "nvidia-lib"

MACHINE_FEATURES = "screen keyboard ethernet pci usbhost acpi ext2 x86"
MACHINE_FEATURES += "rtc"

module_conf_i915 = "options i915 enable_psr=0"

KERNEL_MODULE_PROBECONF += " \
    i915 \
"

KERNEL_MODULE_AUTOLOAD += " \
    psmouse \
    hid-multitouch \
"
```

## conf/machine/xenclient-ndvm.conf
```bitbake
# Copyright (C) 2010 Citrix Systems
# Released under the MIT license (see packages/COPYING)
#@TYPE: Machine
#@NAME: xenclient-ndvm
#@DESCRIPTION: Machine configuration for XenClient secured backend VM

require xenclient-common.conf

MACHINE_FEATURES = "ethernet pci ext2 x86"

APPEND = "root=/dev/xvda2 ro console=hvc0 iommu=soft"

USE_VT = "0"

KERNEL_MODULE_AUTOLOAD += "xen-netback"
```

## conf/machine/xenclient-nilfvm.conf
```bitbake
# Copyright (C) 2010 Citrix Systems
# Released under the MIT license (see packages/COPYING)
#@TYPE: Machine
#@NAME: xenclient-nilfvm
#@DESCRIPTION: Machine configuration for XenClient VPN VM

require xenclient-common.conf

# Use ndvm packages when there's no nilfvm version
PACKAGE_EXTRA_ARCHS_tune-core2 += " xenclient-nvdm "

PREFERRED_PROVIDER_virtual/kernel = "linux-xenclient-nilfvm"
PREFERRED_VERSION_linux-xenclient-nilfvm = "4.1%"
PREFERRED_VERSION_linux-libc-headers = "3.11%"

MACHINE_FEATURES = "kernel26 ethernet pci ext2 x86"

SERIAL_CONSOLE = "38400 xvc0"
```
